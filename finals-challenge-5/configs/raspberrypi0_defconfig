## finals-challenge-5/configs/raspberrypi0_defconfig
```kconfig
BR2_CCACHE=y
BR2_arm=y
BR2_arm1176jz_s=y
BR2_ARM_EABI=y
BR2_ARM_SOFT_FLOAT=y
BR2_ARM_INSTRUCTIONS_THUMB=y
BR2_TAR_OPTIONS="--no-same-owner"
BR2_HOST_DIR="/usr/bin/rpi0_toolchain"
# BR2_GLOBAL_PATCH_DIR="${BR2_EXTERNAL_KUBOS_LINUX_PATH}/common/patches"
BR2_TOOLCHAIN_BUILDROOT_GLIBC=y
BR2_BINUTILS_VERSION_2_31_X=y
BR2_TOOLCHAIN_BUILDROOT_CXX=y
BR2_GCC_ENABLE_LTO=y
BR2_PACKAGE_HOST_GDB=y
BR2_PACKAGE_HOST_GDB_SIM=y
BR2_TARGET_GENERIC_HOSTNAME="Kubos"
BR2_TARGET_GENERIC_ISSUE="Welcome to Kubos Linux"
BR2_ROOTFS_DEVICE_TABLE="system/device_table.txt $(BR2_EXTERNAL)/common/device_table.txt"
BR2_TARGET_GENERIC_ROOT_PASSWD="Kubos123"
BR2_TARGET_GENERIC_GETTY_PORT="ttyAMA0"
BR2_TARGET_GENERIC_GETTY_BAUDRATE_115200=y
BR2_ROOTFS_USERS_TABLES="${BR2_EXTERNAL_KUBOS_LINUX_PATH}/common/users.txt"
BR2_ROOTFS_OVERLAY="$(BR2_EXTERNAL)/common/overlay $(BR2_EXTERNAL)/board/kubos/raspberrypi/overlay"
BR2_ROOTFS_POST_IMAGE_SCRIPT="${BR2_EXTERNAL_KUBOS_LINUX_PATH}/board/kubos/raspberrypi/post-image.sh"
BR2_ROOTFS_POST_SCRIPT_ARGS="${BR2_TARGET_UBOOT_CUSTOM_REPO_VERSION}"
BR2_LINUX_KERNEL=y
# BR2_PTHREADS=y

#BR2_PACKAGE_HOST_LINUX_HEADERS_CUSTOM_4_4=y
#BR2_LINUX_KERNEL_CUSTOM_VERSION=y
#BR2_LINUX_KERNEL_CUSTOM_VERSION_VALUE="4.4.23"
#BR2_LINUX_KERNEL_USE_CUSTOM_CONFIG=y
#BR2_LINUX_KERNEL_CUSTOM_CONFIG_FILE="${BR2_EXTERNAL_KUBOS_LINUX_PATH}/board/kubos/raspberrypi/linux-kubos.config"
#BR2_LINUX_KERNEL_CONFIG_FRAGMENT_FILES="${BR2_EXTERNAL_KUBOS_LINUX_PATH}/common/linux-kubos.config"

#BR2_PACKAGE_HOST_LINUX_HEADERS_CUSTOM_4_14=y
#BR2_LINUX_KERNEL_CUSTOM_TARBALL=y
#BR2_LINUX_KERNEL_CUSTOM_TARBALL_LOCATION="$(call github,raspberrypi,linux,83b36f98e1a48d143f0b466fcf9f8c4e382c9a1c)/linux-83b36f98e1a48d143f0b466fcf9f8c4e382c9a1c.tar.gz"
#BR2_LINUX_KERNEL_DEFCONFIG="bcmrpi"

BR2_PACKAGE_HOST_LINUX_HEADERS_CUSTOM_4_4=y
#BR2_LINUX_KERNEL_CUSTOM_VERSION=y
#BR2_LINUX_KERNEL_CUSTOM_VERSION_VALUE="4.4.23"
BR2_LINUX_KERNEL_CUSTOM_TARBALL=y
BR2_LINUX_KERNEL_CUSTOM_TARBALL_LOCATION="$(call github,raspberrypi,linux,04c8e47067d4873c584395e5cb260b4f170a99ea)/linux-04c8e47067d4873c584395e5cb260b4f170a99ea.tar.gz"
BR2_LINUX_KERNEL_DEFCONFIG="bcmrpi"

BR2_LINUX_KERNEL_USE_CUSTOM_CONFIG=y
BR2_LINUX_KERNEL_CUSTOM_CONFIG_FILE="${BR2_EXTERNAL_KUBOS_LINUX_PATH}/board/kubos/raspberrypi/linux-kubos.config"
BR2_LINUX_KERNEL_CONFIG_FRAGMENT_FILES="${BR2_EXTERNAL_KUBOS_LINUX_PATH}/common/linux-kubos.config"

BR2_PACKAGE_RPI_FIRMWARE=y

BR2_LINUX_KERNEL_LZ4=y
BR2_LINUX_KERNEL_DTS_SUPPORT=y
# BR2_LINUX_KERNEL_INTREE_DTS_NAME="bcm2708-rpi-b-plus"
# BR2_LINUX_KERNEL_INTREE_DTS_NAME="bcm2835-rpi-b-plus"
BR2_LINUX_KERNEL_CUSTOM_DTS_PATH="${BR2_EXTERNAL_KUBOS_LINUX_PATH}/board/kubos/raspberrypi/bcm2708-rpi-zero.dts"
BR2_LINUX_KERNEL_NEEDS_HOST_OPENSSL=y
BR2_PACKAGE_BUSYBOX_CONFIG="${BR2_EXTERNAL_KUBOS_LINUX_PATH}/common/busybox-kubos.config"
BR2_PACKAGE_BUSYBOX_SHOW_OTHERS=y
BR2_PACKAGE_GDB=y
BR2_PACKAGE_GDB_SERVER=y
BR2_PACKAGE_GDB_DEBUGGER=y
BR2_PACKAGE_GDB_TUI=y
BR2_PACKAGE_PV=y
BR2_PACKAGE_DOSFSTOOLS=y
BR2_PACKAGE_DOSFSTOOLS_FSCK_FAT=y
BR2_PACKAGE_E2FSPROGS=y
BR2_PACKAGE_E2FSPROGS_DEBUGFS=y
BR2_PACKAGE_SPI_TOOLS=y
BR2_PACKAGE_UBOOT_TOOLS=y
BR2_PACKAGE_UBOOT_TOOLS_FIT_SUPPORT=y
BR2_PACKAGE_UBOOT_TOOLS_MKIMAGE=y
BR2_PACKAGE_PYTHON3=y
BR2_PACKAGE_PYTHON_NUMPY=y
BR2_PACKAGE_PYTHON_SERIAL=y
BR2_PACKAGE_PYTHON_SETUPTOOLS=y
BR2_PACKAGE_PYTHON_SMBUS_CFFI=y
BR2_PACKAGE_PYTHON_SPIDEV=y
BR2_PACKAGE_PNGQUANT=y
BR2_PACKAGE_PYTHON_PILLOW=y
BR2_PACKAGE_LIBCURL=y
BR2_PACKAGE_CURL=y
BR2_PACKAGE_DROPBEAR=y
BR2_PACKAGE_DROPBEAR_DISABLE_REVERSEDNS=y
BR2_PACKAGE_IFTOP=y
BR2_PACKAGE_LRZSZ=y
BR2_PACKAGE_MONIT=y
BR2_PACKAGE_RSYSLOG=y
BR2_PACKAGE_UTIL_LINUX_LIBFDISK=y
BR2_PACKAGE_UTIL_LINUX_MOUNT=y
BR2_PACKAGE_UTIL_LINUX_UUIDD=y
BR2_PACKAGE_LIBUSB=y
BR2_PACKAGE_LIBUSB_COMPAT=y
BR2_PACKAGE_USBUTILS=y
BR2_PACKAGE_EUDEV=y
BR2_ROOTFS_DEVICE_CREATION_DYNAMIC_EUDEV=y
BR2_TARGET_ROOTFS_EXT2=y
BR2_TARGET_ROOTFS_EXT2_4=y
BR2_TARGET_ROOTFS_EXT2_LABEL="rootfs"
BR2_TARGET_ROOTFS_EXT2_SIZE="128M"
BR2_TARGET_ROOTFS_TAR_LZMA=y
BR2_TARGET_UBOOT=y
BR2_TARGET_UBOOT_BUILD_SYSTEM_KCONFIG=y
BR2_TARGET_UBOOT_CUSTOM_GIT=y
BR2_TARGET_UBOOT_CUSTOM_REPO_URL="https://github.com/kubos/uboot"
BR2_TARGET_UBOOT_CUSTOM_REPO_VERSION="rpi"
BR2_TARGET_UBOOT_USE_CUSTOM_CONFIG=y
BR2_TARGET_UBOOT_CUSTOM_CONFIG_FILE="${BR2_EXTERNAL_KUBOS_LINUX_PATH}/board/kubos/raspberrypi/raspberrypi0_config"
BR2_TARGET_UBOOT_FORMAT_IMG=y
BR2_PACKAGE_HOST_UBOOT_TOOLS_MKIMAGE=y
BR2_PACKAGE_HOST_DOSFSTOOLS=y
BR2_PACKAGE_HOST_GENEXT2FS=y
BR2_PACKAGE_HOST_GENIMAGE=y
BR2_PACKAGE_HOST_MTOOLS=y
BR2_KUBOS_VERSION="1.21.0"
BR2_PACKAGE_KUBOS_SERVICE_LIB=y
BR2_PACKAGE_KUBOS_CORE=y
```
